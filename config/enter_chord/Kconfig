## config/enter_chord/dts/bindings/behaviors/adv360,behavior-enter-chord.yaml
```yaml
description: Advantage360 Command+Option+Enter tap/hold
compatible: "adv360,behavior-enter-chord"
include: zero_param.yaml
properties:
  tapping-term-ms:
    type: int
    required: true
```

## config/staged_mouse/dts/bindings/behaviors/adv360,behavior-staged-mouse.yaml
```yaml
description: Staged mouse movement with instant nudge, crawl, ramp and brake
compatible: "adv360,behavior-staged-mouse"
include: zero_param.yaml
properties:
  x-speed:
    type: int
    required: true
  y-speed:
    type: int
    required: true
  crawl-speed:
    type: int
    default: 90
  crawl-ms:
    type: int
    default: 180
  ramp-ms:
    type: int
    default: 120
  brake-ms:
    type: int
    default: 25
  nudge-px:
    type: int
    default: 3
```
